## config/boards/shields/OniChan/Kconfig.defconfig
```kconfig
if SHIELD_OniChan_LEFT

    config ZMK_KEYBOARD_NAME
        default "OniChan"

    config ZMK_SPLIT_ROLE_CENTRAL
        default y

endif

if SHIELD_OniChan_LEFT || SHIELD_OniChan_RIGHT

    config ZMK_SPLIT
        default y

endif
```

## config/boards/shields/OniChan/Kconfig.shield
```kconfig
# Copyright (c) 2020 Pete Johanson
# SPDX-License-Identifier: MIT

config SHIELD_onichan_LEFT
    def_bool $(shields_list_contains,onichan_left)

config SHIELD_onichan_RIGHT
    def_bool $(shields_list_contains,onichan_right)
```
